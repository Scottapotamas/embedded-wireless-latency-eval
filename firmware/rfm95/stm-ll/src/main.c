/* -------------------------------------------------------------------------- */

#include <string.h>
#include <stdarg.h>
#include <stdint.h>
#include <stdbool.h>

#include "stm32f4xx_ll_cortex.h"
#include <stm32f4xx_ll_rcc.h>
#include <stm32f4xx_ll_system.h>
#include <stm32f4xx_ll_bus.h>
#include <stm32f4xx_ll_pwr.h>
#include <stm32f4xx_ll_utils.h>

#include "stm32f4xx_ll_gpio.h"
#include "stm32f4xx_ll_exti.h"
#include "stm32f4xx_ll_spi.h"

/* -------------------------------------------------------------------------- */

#define PAYLOAD_12B
//#define PAYLOAD_128B
// #define PAYLOAD_1024B

/* -------------------------------------------------------------------------- */

void hal_core_init( void );
void hal_core_clock_configure( void );
void portAssertHandler( const char *file,
                        unsigned    line,
                        const char *fmt,
                        ... );

/* -------------------------------------------------------------------------- */

void setup_gpio_output( void );
void setup_gpio_input( void );
void setup_rfm95_io( void );
void setup_spi( void );

/* -------------------------------------------------------------------------- */

static void crc16(uint8_t data, uint16_t *crc);
volatile bool trigger_pending = false;

#define CRC_SEED (0xFFFFu)
uint32_t bytes_to_send = 0;
uint32_t bytes_sent = 0;
uint32_t bytes_read = 0;
uint16_t working_crc = CRC_SEED;
uint16_t payload_crc = 0x00;

#if defined(PAYLOAD_12B)
    uint8_t test_payload[12] = {
            0x00,
            0x01, 0x02, 0x03, 0x04, 0x05,
            0x06, 0x07, 0x08, 0x09, 0x0A,
            0x0B,
    };
#elif defined(PAYLOAD_128B)
    uint8_t test_payload[128] = {
            0x00,
            0x01, 0x02, 0x03, 0x04, 0x05, 0x06, 0x07, 0x08, 0x09, 0x0A,
            0x0B, 0x0C, 0x0D, 0x0E, 0x0F, 0x10, 0x11, 0x12, 0x13, 0x14,
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            0x79, 0x7A, 0x7B, 0x7C, 0x7D, 0x7E, 0x7F,
    };
#elif defined(PAYLOAD_1024B)
    uint8_t test_payload[1024] = {
            0x00,
            // Sequential set of 255 bytes
            0x01, 0x02, 0x03, 0x04, 0x05, 0x06, 0x07, 0x08, 0x09, 0x0A,
            0x0B, 0x0C, 0x0D, 0x0E, 0x0F, 0x10, 0x11, 0x12, 0x13, 0x14,
            0x15, 0x16, 0x17, 0x18, 0x19, 0x1A, 0x1B, 0x1C, 0x1D, 0x1E,
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            0xFB, 0xFC, 0xFD, 0xFE, 0xFF,

            // Next run of 255 bytes consumes 510 bytes
            0x01, 0x01, 0x01, 0x02, 0x01, 0x03, 0x01, 0x04,0x01, 0x05,
            0x01, 0x06, 0x01, 0x07, 0x01, 0x08, 0x01, 0x09,0x01, 0x0A,
            0x01, 0x0B, 0x01, 0x0C, 0x01, 0x0D, 0x01, 0x0E,0x01, 0x0F,
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            0x01, 0xFB, 0x01, 0xFC, 0x01, 0xFD, 0x01, 0xFE,  0x01, 0xFF,

            // 1+255+510 bytes are done, this is the remaining 258B for total of 1024
            0x02, 0x01, 0x02, 0x02, 0x02, 0x03, 0x02, 0x04, 0x02, 0x05,
            0x02, 0x06, 0x02, 0x07, 0x02, 0x08, 0x02, 0x09, 0x02, 0x0A,
            0x02, 0x0B, 0x02, 0x0C, 0x02, 0x0D, 0x02, 0x0E, 0x02, 0x0F,
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            0x02, 0x7E, 0x02, 0x7F, 0x02, 0x80, 0x02, 0x81
    };
#endif

/* -------------------------------------------------------------------------- */

uint8_t rx_tmp[32] = { 0 };

/* -------------------------------------------------------------------------- */

int main(void)
{
    hal_core_init();
    hal_core_clock_configure();

    setup_gpio_output();
    setup_gpio_input();

    // RFM9x init/setup
    setup_rfm95_io();
    setup_spi();

    // Work out the correct CRC for the active payload
    working_crc = CRC_SEED;
    for( uint32_t i = 0; i < sizeof(test_payload); i++ )
    {
        crc16( test_payload[i], &working_crc );
    }

    payload_crc = working_crc;
    working_crc = CRC_SEED;

    // Radio setup
    // TODO: Configure radio module

    while(1)
    {

        // TODO: read inbound bytes into a buffer for processing
        uint32_t bytes_held = 0;

        // Check inbound data for valid test payload sequences
        if( bytes_held )
        {
            for( uint8_t i = 0; i < bytes_held; i++ )
            {
                // Reset the "parser"
                if(rx_tmp[i] == 0x00 )
                {
                    bytes_read = 0;
                    working_crc = CRC_SEED;
                }

                crc16( rx_tmp[i], &working_crc );
                bytes_read++;

                // Identify the end of the packet via expected length and correct CRC
                if( bytes_read == sizeof(test_payload) && working_crc == payload_crc )
                {
                    LL_GPIO_SetOutputPin( GPIOB, LL_GPIO_PIN_0 );
                }

            }

            bytes_held = 0;
            memset(rx_tmp, 0, sizeof(rx_tmp));

            LL_GPIO_ResetOutputPin( GPIOB, LL_GPIO_PIN_0 );
        }

        // Send a packet when triggered
        if(trigger_pending)
        {
            // Send a packet

//            LL_GPIO_SetOutputPin( GPIOB, LL_GPIO_PIN_0 );
            trigger_pending = false;
        }
        else
        {
            // GPIO low
//            LL_GPIO_ResetOutputPin( GPIOB, LL_GPIO_PIN_0 );
        }
    }

    return 0;
}

/* -------------------------------------------------------------------------- */

static void crc16(uint8_t data, uint16_t *crc)
{
    *crc  = (uint8_t)(*crc >> 8) | (*crc << 8);
    *crc ^= data;
    *crc ^= (uint8_t)(*crc & 0xff) >> 4;
    *crc ^= (*crc << 8) << 4;
    *crc ^= ((*crc & 0xff) << 4) << 1;
}

/* -------------------------------------------------------------------------- */

void setup_gpio_output( void )
{
    LL_PWR_DisableWakeUpPin( LL_PWR_WAKEUP_PIN1 );

    // PB0
    LL_AHB1_GRP1_EnableClock( LL_AHB1_GRP1_PERIPH_GPIOB );

    LL_GPIO_SetPinMode( GPIOB, LL_GPIO_PIN_0, LL_GPIO_MODE_OUTPUT );
    LL_GPIO_SetPinSpeed( GPIOB, LL_GPIO_PIN_0, LL_GPIO_SPEED_FREQ_LOW );
    LL_GPIO_SetPinOutputType( GPIOB, LL_GPIO_PIN_0, LL_GPIO_OUTPUT_PUSHPULL );
    LL_GPIO_SetPinPull( GPIOB, LL_GPIO_PIN_0, LL_GPIO_PULL_NO );
    LL_GPIO_ResetOutputPin( GPIOB, LL_GPIO_PIN_0 );
}

/* -------------------------------------------------------------------------- */

void setup_gpio_input( void )
{
    // PA0 as input
    LL_AHB1_GRP1_EnableClock( LL_AHB1_GRP1_PERIPH_GPIOA );

    LL_GPIO_SetPinMode( GPIOA, LL_GPIO_PIN_0, LL_GPIO_MODE_INPUT );
    LL_GPIO_SetPinSpeed( GPIOA, LL_GPIO_PIN_0, LL_GPIO_SPEED_FREQ_LOW );
    LL_GPIO_SetPinOutputType( GPIOA, LL_GPIO_PIN_0, LL_GPIO_MODE_INPUT );
    LL_GPIO_SetPinPull( GPIOA, LL_GPIO_PIN_0, LL_GPIO_PULL_NO );
    LL_GPIO_ResetOutputPin( GPIOA, LL_GPIO_PIN_0 );

    // EXTI0 setup
    LL_EXTI_EnableIT_0_31(LL_EXTI_LINE_0);
    LL_EXTI_EnableRisingTrig_0_31(LL_EXTI_LINE_0);

    LL_SYSCFG_SetEXTISource(LL_SYSCFG_EXTI_PORTA, LL_SYSCFG_EXTI_LINE0);

    // IRQ config
    NVIC_SetPriority(EXTI0_IRQn, NVIC_EncodePriority(
            NVIC_GetPriorityGrouping(),
            0,
            0
            ));
    NVIC_EnableIRQ(EXTI0_IRQn);

}

/* -------------------------------------------------------------------------- */

void setup_rfm95_io( void )
{
    // PB4 - Chip enable
    LL_AHB1_GRP1_EnableClock( LL_AHB1_GRP1_PERIPH_GPIOB );

    LL_GPIO_SetPinMode( GPIOB, LL_GPIO_PIN_4, LL_GPIO_MODE_OUTPUT );
    LL_GPIO_SetPinSpeed( GPIOB, LL_GPIO_PIN_4, LL_GPIO_SPEED_FREQ_LOW );
    LL_GPIO_SetPinOutputType( GPIOB, LL_GPIO_PIN_4, LL_GPIO_OUTPUT_PUSHPULL );
    LL_GPIO_SetPinPull( GPIOB, LL_GPIO_PIN_4, LL_GPIO_PULL_NO );
    LL_GPIO_ResetOutputPin( GPIOB, LL_GPIO_PIN_4 );

    // PB3 - IRQ pin
    LL_GPIO_SetPinMode( GPIOB, LL_GPIO_PIN_3, LL_GPIO_MODE_INPUT );
    LL_GPIO_SetPinSpeed( GPIOB, LL_GPIO_PIN_3, LL_GPIO_SPEED_FREQ_HIGH );
    LL_GPIO_SetPinPull( GPIOB, LL_GPIO_PIN_3, LL_GPIO_PULL_NO );
    LL_GPIO_ResetOutputPin( GPIOB, LL_GPIO_PIN_3 );

    // EXTI1 setup
    LL_EXTI_EnableIT_0_31(LL_EXTI_LINE_3);
    LL_EXTI_EnableFallingTrig_0_31(LL_EXTI_LINE_3);

    LL_SYSCFG_SetEXTISource(LL_SYSCFG_EXTI_PORTB, LL_SYSCFG_EXTI_LINE3);
    LL_EXTI_ClearFlag_0_31(LL_EXTI_LINE_3);

    // IRQ config
    NVIC_SetPriority(EXTI3_IRQn, NVIC_EncodePriority(
            NVIC_GetPriorityGrouping(),
            0,
            0
    ));
    NVIC_EnableIRQ(EXTI3_IRQn);

}

/* -------------------------------------------------------------------------- */

void setup_spi( void )
{
    // IO setup in alternate function mode
    LL_AHB1_GRP1_EnableClock( LL_AHB1_GRP1_PERIPH_GPIOA );

    // PA5 for SPI CLK
    LL_GPIO_SetPinMode( GPIOA, LL_GPIO_PIN_5, LL_GPIO_MODE_OUTPUT );
    LL_GPIO_SetPinMode( GPIOA, LL_GPIO_PIN_5, LL_GPIO_MODE_ALTERNATE );
    LL_GPIO_SetAFPin_0_7( GPIOA, LL_GPIO_PIN_5, LL_GPIO_AF_5 );
    LL_GPIO_SetPinSpeed( GPIOA, LL_GPIO_PIN_5, LL_GPIO_SPEED_FREQ_VERY_HIGH );
    LL_GPIO_SetPinOutputType( GPIOA, LL_GPIO_PIN_5, LL_GPIO_OUTPUT_PUSHPULL );
    LL_GPIO_SetPinPull( GPIOA, LL_GPIO_PIN_5, LL_GPIO_PULL_NO );

    // PA6 for SPI MISO
    LL_GPIO_SetPinMode( GPIOA, LL_GPIO_PIN_6, LL_GPIO_MODE_OUTPUT );
    LL_GPIO_SetPinMode( GPIOA, LL_GPIO_PIN_6, LL_GPIO_MODE_ALTERNATE );
    LL_GPIO_SetAFPin_0_7( GPIOA, LL_GPIO_PIN_6, LL_GPIO_AF_5 );
    LL_GPIO_SetPinSpeed( GPIOA, LL_GPIO_PIN_6, LL_GPIO_SPEED_FREQ_VERY_HIGH );
    LL_GPIO_SetPinOutputType( GPIOA, LL_GPIO_PIN_6, LL_GPIO_OUTPUT_PUSHPULL );
    LL_GPIO_SetPinPull( GPIOA, LL_GPIO_PIN_6, LL_GPIO_PULL_NO );

    // PA7 for SPI MOSI
    LL_GPIO_SetPinMode( GPIOA, LL_GPIO_PIN_7, LL_GPIO_MODE_OUTPUT );
    LL_GPIO_SetPinMode( GPIOA, LL_GPIO_PIN_7, LL_GPIO_MODE_ALTERNATE );
    LL_GPIO_SetAFPin_0_7( GPIOA, LL_GPIO_PIN_7, LL_GPIO_AF_5 );
    LL_GPIO_SetPinSpeed( GPIOA, LL_GPIO_PIN_7, LL_GPIO_SPEED_FREQ_VERY_HIGH );
    LL_GPIO_SetPinOutputType( GPIOA, LL_GPIO_PIN_7, LL_GPIO_OUTPUT_PUSHPULL );
    LL_GPIO_SetPinPull( GPIOA, LL_GPIO_PIN_7, LL_GPIO_PULL_NO );

    // PA4 for Chip select
    LL_GPIO_SetPinMode( GPIOA, LL_GPIO_PIN_4, LL_GPIO_MODE_OUTPUT );
    LL_GPIO_SetPinSpeed( GPIOA, LL_GPIO_PIN_4, LL_GPIO_SPEED_FREQ_HIGH );
    LL_GPIO_SetPinOutputType( GPIOA, LL_GPIO_PIN_4, LL_GPIO_OUTPUT_PUSHPULL );
    LL_GPIO_SetPinPull( GPIOA, LL_GPIO_PIN_4, LL_GPIO_PULL_NO );
    LL_GPIO_ResetOutputPin( GPIOA, LL_GPIO_PIN_4 );

    // SPI Setup
    LL_APB2_GRP1_EnableClock(LL_APB2_GRP1_PERIPH_SPI1);

    LL_SPI_SetTransferDirection( SPI1, LL_SPI_FULL_DUPLEX );
    LL_SPI_SetMode( SPI1, LL_SPI_MODE_MASTER );
    LL_SPI_SetDataWidth( SPI1, LL_SPI_DATAWIDTH_8BIT );
    LL_SPI_SetClockPolarity( SPI1, LL_SPI_POLARITY_LOW );
    LL_SPI_SetClockPhase( SPI1, LL_SPI_PHASE_1EDGE );
    LL_SPI_SetNSSMode( SPI1, LL_SPI_NSS_SOFT );
    LL_SPI_SetBaudRatePrescaler(SPI1, LL_SPI_BAUDRATEPRESCALER_DIV8 );
    LL_SPI_SetTransferBitOrder( SPI1, LL_SPI_MSB_FIRST );
    LL_SPI_DisableCRC( SPI1 );
    LL_SPI_SetCRCPolynomial( SPI1, 10 );
    LL_SPI_SetStandard( SPI1, LL_SPI_PROTOCOL_MOTOROLA );

    LL_SPI_Enable(SPI1);
}

/* -------------------------------------------------------------------------- */

void SysTick_Handler(void)
{

}

// Trigger IO IRQ
void EXTI0_IRQHandler(void)
{
    if(LL_EXTI_IsActiveFlag_0_31(LL_EXTI_LINE_0))
    {
        LL_EXTI_ClearFlag_0_31(LL_EXTI_LINE_0);
        trigger_pending = true;
    }
}

// SPI IRQ handling
void EXTI3_IRQHandler(void)
{
    if(LL_EXTI_IsActiveFlag_0_31(LL_EXTI_LINE_3))
    {
        LL_EXTI_ClearFlag_0_31(LL_EXTI_LINE_3);
        // TODO: handle IRQ?
    }
}

/* -------------------------------------------------------------------------- */

void hal_core_init( void )
{
    LL_FLASH_EnableInstCache();
    LL_FLASH_EnableDataCache();
    LL_FLASH_EnablePrefetch();

    LL_APB2_GRP1_EnableClock( LL_APB2_GRP1_PERIPH_SYSCFG );
    LL_APB1_GRP1_EnableClock( LL_APB1_GRP1_PERIPH_PWR );

    NVIC_SetPriority( MemoryManagement_IRQn, NVIC_EncodePriority( NVIC_GetPriorityGrouping(), 0, 0 ) );
    NVIC_SetPriority( BusFault_IRQn, NVIC_EncodePriority( NVIC_GetPriorityGrouping(), 0, 0 ) );
    NVIC_SetPriority( UsageFault_IRQn, NVIC_EncodePriority( NVIC_GetPriorityGrouping(), 0, 0 ) );
    NVIC_SetPriority( SVCall_IRQn, NVIC_EncodePriority( NVIC_GetPriorityGrouping(), 0, 0 ) );
    NVIC_SetPriority( DebugMonitor_IRQn, NVIC_EncodePriority( NVIC_GetPriorityGrouping(), 0, 0 ) );
    NVIC_SetPriority( PendSV_IRQn, NVIC_EncodePriority( NVIC_GetPriorityGrouping(), 0, 0 ) );
    NVIC_SetPriority( SysTick_IRQn, NVIC_EncodePriority( NVIC_GetPriorityGrouping(), 0, 0 ) );
}


// Startup the internal and external clocks, set PLL etc
void hal_core_clock_configure( void )
{
    LL_FLASH_SetLatency( LL_FLASH_LATENCY_5 );

    if( LL_FLASH_GetLatency() != LL_FLASH_LATENCY_5 )
    {
        portAssertHandler("main.c", __LINE__, 0);
    }

    LL_PWR_SetRegulVoltageScaling( LL_PWR_REGU_VOLTAGE_SCALE1 );
    LL_PWR_DisableOverDriveMode();
    LL_RCC_HSE_EnableBypass();

    LL_RCC_HSE_Enable();
    while( LL_RCC_HSE_IsReady() != 1 )
    {
    }

//    LL_RCC_LSI_Enable();
//    while( LL_RCC_LSI_IsReady() != 1 )
//    {
//    }

    LL_RCC_PLL_ConfigDomain_SYS( LL_RCC_PLLSOURCE_HSE, LL_RCC_PLLM_DIV_4, 168, LL_RCC_PLLP_DIV_2 );
    LL_RCC_PLL_ConfigDomain_48M( LL_RCC_PLLSOURCE_HSE, LL_RCC_PLLM_DIV_4, 168, LL_RCC_PLLQ_DIV_7 );
    LL_RCC_PLL_Enable();
    while( LL_RCC_PLL_IsReady() != 1 )
    {
    }
    while( LL_PWR_IsActiveFlag_VOS() == 0 )
    {
    }

    LL_RCC_SetAHBPrescaler( LL_RCC_SYSCLK_DIV_1 );
    LL_RCC_SetAPB1Prescaler( LL_RCC_APB1_DIV_4 );
    LL_RCC_SetAPB2Prescaler( LL_RCC_APB2_DIV_2 );

    LL_RCC_SetSysClkSource( LL_RCC_SYS_CLKSOURCE_PLL );
    while( LL_RCC_GetSysClkSource() != LL_RCC_SYS_CLKSOURCE_STATUS_PLL )
    {
    }

    LL_Init1msTick( 168000000 );
    LL_SetSystemCoreClock( 168000000 );
//    LL_RCC_SetTIMPrescaler( LL_RCC_TIM_PRESCALER_TWICE );

    LL_SYSTICK_EnableIT();
}

void portAssertHandler( const char *file,
                        unsigned    line,
                        const char *fmt,
                        ... )
{
    va_list  args;

    // Forward directly to the 'in-memory cache' handler function
    va_start( args, fmt );
    // Read/handle file/line strings here
    va_end( args );

    // Wait for the watch dog to bite
    for( ;; )
    {
        asm("NOP");
    }

}

/* -------------------------------------------------------------------------- */