#include <stdlib.h>
#include <time.h>
#include <string.h>
#include <assert.h>
#include <stdio.h>
#include <inttypes.h>

#include "freertos/FreeRTOS.h"
#include "freertos/semphr.h"
#include "freertos/timers.h"
#include "freertos/task.h"

#include "esp_system.h"
#include "esp_log.h"
#include "nvs.h"
#include "nvs_flash.h"

#include "esp_ieee802154.h"
#include "esp_ieee802154_types.h"
#include "esp_phy_init.h"

#include "linenoise/linenoise.h"
#include "argtable3/argtable3.h"
#include "soc/soc.h"
#include "soc/ieee802154_reg.h"

#include "driver/gpio.h"

/* -------------------------------------------------------------------------- */

// Packet size test length settings

// #define PAYLOAD_12B
// #define PAYLOAD_128B
#define PAYLOAD_1024B

/* -------------------------------------------------------------------------- */

// Test stimulus input pin
#define GPIO_INPUT_IO_0     19
#define GPIO_INPUT_PIN_SEL  ((1ULL<<GPIO_INPUT_IO_0))

// Status output pin
#define GPIO_OUTPUT_IO_0    18
#define GPIO_OUTPUT_IO_LED  2   // onboard LED signals if the board has added a peer

#define GPIO_OUTPUT_PIN_SEL  ((1ULL<<GPIO_OUTPUT_IO_0) | (1ULL<<GPIO_OUTPUT_IO_LED))

#define ESP_INTR_FLAG_DEFAULT 0

/* -------------------------------------------------------------------------- */

#define FRAME_MAX_LENGTH (127)    // Max 802.15.4-2011 frame is 127 bytes

typedef struct
{
    uint8_t frame_type: 3;          // bits 0-2
    uint8_t secured: 1;             // bit 3
    uint8_t pending: 1;
    uint8_t ack_request: 1;
    uint8_t pan_id_compression: 1;
    uint8_t reserved: 1;            // bit 7
    uint8_t seq_num_suppression: 1;
    uint8_t inf_elements_present: 1;
    uint8_t dest_address_mode: 2;   // bits 10-11
    uint8_t frame_version: 2;       // bits 12-13
    uint8_t src_address_mode: 2;    // bits 14-15
} mhr_format_t;

typedef struct
{
    uint8_t     frame_length;
    uint8_t     seq_num;
    uint16_t    mac_header;         // TODO: refactor to use mhr_format_t here
    uint16_t    pan_destination;
    uint16_t    destination;
    uint16_t    source;
    uint16_t    fcs;
} frame_fields_t;


/* -------------------------------------------------------------------------- */

// Settings
#define MAX_PAYLOAD_BYTES (FRAME_MAX_LENGTH - 11)
// #define MAX_PAYLOAD_BYTES (64)
#define EVT_QUEUE_SIZE (8)

static const char *TAG = "app";

static QueueHandle_t event_queue;

static uint8_t tx_frame[131] = { 0 };
static uint8_t seq_num = 0;

typedef enum {
    RADIO_SEND_CB,
    RADIO_RECV_CB,
} radio_event_id_t;

typedef struct {
    uint8_t frame_bytes;
    uint8_t ack_bytes;
} radio_send_cb_t;

typedef struct {
    uint8_t *data;
    int data_len;
} radio_recv_cb_t;

typedef union {
    radio_send_cb_t send_cb;
    radio_recv_cb_t recv_cb;
} radio_event_info_t;

// // Main task queue needs to support send and receive events
// // The ID field helps distinguish between them
typedef struct {
    radio_event_id_t id;
    radio_event_info_t info;
} radio_event_t;


/* -------------------------------------------------------------------------- */

volatile bool trigger_pending = false;

#define CRC_SEED (0xFFFFu)
uint16_t bytes_read = 0;
uint16_t working_crc = CRC_SEED;
uint16_t payload_crc = 0x00;

#if defined(PAYLOAD_12B)
    uint8_t test_payload[12] = {
            0x00,
            0x01, 0x02, 0x03, 0x04, 0x05,
            0x06, 0x07, 0x08, 0x09, 0x0A,
            0x0B,
    };
#elif defined(PAYLOAD_128B)
    uint8_t test_payload[128] = {
            0x00,
            0x01, 0x02, 0x03, 0x04, 0x05, 0x06, 0x07, 0x08, 0x09, 0x0A,
            0x0B, 0x0C, 0x0D, 0x0E, 0x0F, 0x10, 0x11, 0x12, 0x13, 0x14,
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            0x79, 0x7A, 0x7B, 0x7C, 0x7D, 0x7E, 0x7F,
    };
#elif defined(PAYLOAD_1024B)
    uint8_t test_payload[1024] = {
            0x00,
            // Sequential set of 255 bytes
            0x01, 0x02, 0x03, 0x04, 0x05, 0x06, 0x07, 0x08, 0x09, 0x0A,
            0x0B, 0x0C, 0x0D, 0x0E, 0x0F, 0x10, 0x11, 0x12, 0x13, 0x14,
            0x15, 0x16, 0x17, 0x18, 0x19, 0x1A, 0x1B, 0x1C, 0x1D, 0x1E,
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            0xFB, 0xFC, 0xFD, 0xFE, 0xFF,

            // Next run of 255 bytes consumes 510 bytes
            0x01, 0x01, 0x01, 0x02, 0x01, 0x03, 0x01, 0x04,0x01, 0x05,
            0x01, 0x06, 0x01, 0x07, 0x01, 0x08, 0x01, 0x09,0x01, 0x0A,
            0x01, 0x0B, 0x01, 0x0C, 0x01, 0x0D, 0x01, 0x0E,0x01, 0x0F,
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            0x01, 0xFB, 0x01, 0xFC, 0x01, 0xFD, 0x01, 0xFE,  0x01, 0xFF,

            // 1+255+510 bytes are done, this is the remaining 258B for total of 1024
            0x02, 0x01, 0x02, 0x02, 0x02, 0x03, 0x02, 0x04, 0x02, 0x05,
            0x02, 0x06, 0x02, 0x07, 0x02, 0x08, 0x02, 0x09, 0x02, 0x0A,
            0x02, 0x0B, 0x02, 0x0C, 0x02, 0x0D, 0x02, 0x0E, 0x02, 0x0F,
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            0x02, 0x7E, 0x02, 0x7F, 0x02, 0x80, 0x02, 0x81
    };
#endif

/* -------------------------------------------------------------------------- */


static void setup_gpio_output( void );
static void setup_gpio_input( void );
static void IRAM_ATTR gpio_isr_handler(void* arg);

static void crc16(uint8_t data, uint16_t *crc);

static void radio_init(void);
static void transmit_packet( uint8_t *buffer, uint16_t length );


static void benchmark_task(void *pvParameter);

/* -------------------------------------------------------------------------- */

void setup_gpio_output( void )
{
    gpio_config_t io_conf = {};

    // Output pin
    io_conf.intr_type = GPIO_INTR_DISABLE;
    io_conf.mode = GPIO_MODE_OUTPUT;
    io_conf.pin_bit_mask = GPIO_OUTPUT_PIN_SEL;
    io_conf.pull_down_en = 0;
    io_conf.pull_up_en = 0;
    gpio_config(&io_conf);
}

/* -------------------------------------------------------------------------- */

void setup_gpio_input( void )
{
    gpio_config_t io_conf = {};

    // Input pin with rising edge interrupt
    io_conf.intr_type = GPIO_INTR_POSEDGE;
    io_conf.mode = GPIO_MODE_INPUT;
    io_conf.pin_bit_mask = GPIO_INPUT_PIN_SEL;
    io_conf.pull_down_en = 0;
    io_conf.pull_up_en = 0;
    gpio_config(&io_conf);

    // ISR setup
    gpio_install_isr_service(ESP_INTR_FLAG_DEFAULT);
    gpio_isr_handler_add(GPIO_INPUT_IO_0, gpio_isr_handler, (void*) GPIO_INPUT_IO_0);
}

static void IRAM_ATTR gpio_isr_handler(void* arg)
{
    trigger_pending = true;
}

/* -------------------------------------------------------------------------- */

static void crc16(uint8_t data, uint16_t *crc)
{
    *crc  = (uint8_t)(*crc >> 8) | (*crc << 8);
    *crc ^= data;
    *crc ^= (uint8_t)(*crc & 0xff) >> 4;
    *crc ^= (*crc << 8) << 4;
    *crc ^= ((*crc & 0xff) << 4) << 1;
}

/* -------------------------------------------------------------------------- */

static void radio_init(void)
{
    // Enable ESP's internal subsystem
    esp_ieee802154_enable();

    // Starting configuration
    uint8_t channel = esp_ieee802154_get_channel();
    esp_ieee802154_set_channel(11);

    int8_t txpower = esp_ieee802154_get_txpower();
    esp_ieee802154_set_txpower( 20 );

    // Non-blocking receive
    esp_ieee802154_receive();
    esp_ieee802154_set_rx_when_idle(true);

}

/* -------------------------------------------------------------------------- */

// RX callback
void esp_ieee802154_receive_done(   uint8_t *frame, 
                                    esp_ieee802154_frame_info_t *frame_info
                                )
{
    uint8_t index = 0;

    frame_fields_t meta = { 0 };
    meta.frame_length   = frame[0]; // first byte is the total frame size in bytes
    index += 1;

    // Header fields
    meta.mac_header       = frame[1] | (frame[2] << 8);    
    meta.seq_num          = frame[3];
    meta.pan_destination  = frame[4] | (frame[5] << 8);
    meta.destination      = frame[6] | (frame[7] << 8);
    meta.source           = frame[8] | (frame[9] << 8);
    // The FCS should be the final two bytes of the payload
    meta.fcs              =  frame[meta.frame_length] 
                                    | (frame[meta.frame_length-1] << 8);
    index += 9;

    // TODO: this information isn't passed on, can we form valid MAC frames without it being correctly handled?

    // Send an event to the benchmark task
    radio_event_t evt;
    evt.id = RADIO_RECV_CB; // Format the event object
    radio_recv_cb_t *recv_cb = &evt.info.recv_cb;

    uint8_t payload_length = meta.frame_length - index - 1; // minus FCS

    // Allocate a sufficiently large chunk of memory and copy the payload into it
    recv_cb->data = malloc(payload_length);
    if( recv_cb->data == NULL )
    {
        ESP_EARLY_LOGI("RX", "Malloc receive data fail");
        return;
    }

    memcpy(recv_cb->data, &frame[index], payload_length);
    recv_cb->data_len = payload_length;

    // Send it to the user's task for further processing
    BaseType_t xHigherPriorityTaskWoken = pdFALSE;
    xQueueSendToBackFromISR( event_queue, &evt, &xHigherPriorityTaskWoken );

    if( xHigherPriorityTaskWoken )
    {
        portYIELD_FROM_ISR();
    }
}

// TXcomplete callback
void esp_ieee802154_transmit_done(  const uint8_t *frame, 
                                    const uint8_t *ack, 
                                    esp_ieee802154_frame_info_t *ack_frame_info 
                                 )
{
    radio_event_t evt;
    evt.id = RADIO_SEND_CB;
    radio_send_cb_t *send_cb = &evt.info.send_cb;

    // send_cb->ack_bytes = ack[0];
    send_cb->frame_bytes = frame[0];

    BaseType_t xHigherPriorityTaskWoken = pdFALSE;
    xQueueSendToBackFromISR( event_queue, &evt, &xHigherPriorityTaskWoken );

    if( xHigherPriorityTaskWoken )
    {
        portYIELD_FROM_ISR();
    }
}

/* -------------------------------------------------------------------------- */

static void transmit_packet( uint8_t *buffer, uint16_t length )
{
    // These frames have been validated via wireshark sniffing and decode.
    // Don't copy this code for your project, the PAN/Dest/Source addresses 
    // aren't correct and the MHR is hardcoded!

    uint8_t index = 1;
    memset( &tx_frame[0], 0, sizeof(tx_frame) );

    frame_fields_t meta = { 0 };

    // Header fields
    // Frame Control Field: 0x8861 
    // Frame Type: Data
    // Acknowledge Request
    // PAN ID Compression 
    // Destination Addressing Mode: Short/16-bit 
    // Frame Version: IEEE Std 802.15.4-2003 
    // Source Addressing Mode: Short/16-bit
    //meta.mac_header       = 0x8861;    

    // Same as above, but don't require ACK
    meta.mac_header       = 0x8841;    

    meta.seq_num          = seq_num++;
    meta.pan_destination  = 0x0007; // just a random PAN
    meta.destination      = 0xFFFF; // broadcast
    meta.source           = 0x8899; // also a random source
    meta.fcs              = 0x0000; // calculated for us

    // Encode MAC fields into buffer
    tx_frame[1] = meta.mac_header & 0xFF;
    tx_frame[2] = (meta.mac_header >> 8);
    tx_frame[3] = meta.seq_num;
    tx_frame[4] = meta.pan_destination & 0xFF;
    tx_frame[5] = (meta.pan_destination >> 8);
    tx_frame[6] = meta.destination & 0xFF;
    tx_frame[7] = (meta.destination >> 8);
    tx_frame[8] = meta.source & 0xFF;
    tx_frame[9] = (meta.source >> 8);
    index += 9;

    // Copy the user's payload
    memcpy( &tx_frame[index], buffer, length );
    index += length+1;
    tx_frame[0] = index; // total packet length

    // ESP_LOG_BUFFER_HEXDUMP(TAG, tx_frame, index, ESP_LOG_INFO);
    esp_ieee802154_transmit(tx_frame, false);
}

/* -------------------------------------------------------------------------- */

static void benchmark_task(void *pvParameter)
{
    radio_event_t evt;
    uint16_t bytes_sent = 0;

    // Main event loop
    while(1)
    {
        if(trigger_pending)
        {
            // Payload
            bytes_sent = 0;
            uint16_t bytes_to_send = sizeof(test_payload) - bytes_sent;
            if( bytes_to_send > MAX_PAYLOAD_BYTES )
            {
                bytes_to_send = MAX_PAYLOAD_BYTES;
            }

            // ESP_LOGI(TAG, "Trigger sent %d sending %d", bytes_sent, bytes_to_send);

            // Send the buffer
            transmit_packet( &test_payload[bytes_sent], bytes_to_send );
            
            // We wait for a tx complete callback and handle subsequent split packets
            // in the event handling code below

            // Cleanup
            trigger_pending = false;
        }

        // Handle events from the radio
        if( xQueueReceive(event_queue, &evt, 1) )
        {
            switch( evt.id )
            {
                // Sent a packet
                case RADIO_SEND_CB:
                {
                    radio_send_cb_t *send_cb = &evt.info.send_cb;
                    bytes_sent += send_cb->frame_bytes - 11; // Don't count the MAC fields or fcs

                    // Send the next chunk if needed
                    if( bytes_sent < sizeof(test_payload) )
                    {
                        uint16_t bytes_to_send = sizeof(test_payload) - bytes_sent;
                        if( bytes_to_send > MAX_PAYLOAD_BYTES )
                        {
                            bytes_to_send = MAX_PAYLOAD_BYTES;
                        }

                        // ESP_LOGI(TAG, "Chunk starting %d len %d", bytes_sent, bytes_to_send);
                        transmit_packet( &test_payload[bytes_sent], bytes_to_send );
                    }

                    break;
                } // end tx callback handling

                case RADIO_RECV_CB:
                {
                    // Destructure the callback into something more ergonomic
                    radio_recv_cb_t *recv_cb = &evt.info.recv_cb;

                    // ESP_LOGI(TAG, "Receive %d bytes", recv_cb->data_len);

                    for( uint8_t i = 0; i < recv_cb->data_len; i++ )
                    {
                        // ESP_LOGI(TAG, "%d: %d", i, recv_cb->data[i]);

                        // Reset the "parser" if the start of a new test structure is seen
                        if(recv_cb->data[i] == 0x00 )
                        {
                            bytes_read = 0;
                            working_crc = CRC_SEED;
                        }

                        // Running crc and byte count
                        crc16( recv_cb->data[i], &working_crc );
                        bytes_read++;

                        // Identify the end of the packet via expected length and correct CRC
                        if( bytes_read == sizeof(test_payload) && working_crc == payload_crc )
                        {
                            // Valid test structure
                            gpio_set_level( GPIO_OUTPUT_IO_0, 1 );
                        }
                    }

                    gpio_set_level( GPIO_OUTPUT_IO_0, 0 );
                    
                    // The rx callback uses malloc to store the inbound data
                    // so clean up after we're done handling that data
                    free( recv_cb->data );

                    break;
                }   // end rx callback handling

                default:
                    ESP_LOGE(TAG, "Invalid callback type: %d", evt.id);
                    break;
            }
        }   // end evtxQueueReceive

    }   // end event loop
}

/* -------------------------------------------------------------------------- */

void app_main(void)
{
    // Initialize NVS
    esp_err_t ret = nvs_flash_init();
    if (ret == ESP_ERR_NVS_NO_FREE_PAGES || ret == ESP_ERR_NVS_NEW_VERSION_FOUND)
    {
        ESP_ERROR_CHECK( nvs_flash_erase() );
        ret = nvs_flash_init();
    }
    ESP_ERROR_CHECK( ret );

    // General setup
    setup_gpio_output();
    setup_gpio_input();

    // Work out the correct CRC for the active payload
    working_crc = CRC_SEED;
    for( uint16_t i = 0; i < sizeof(test_payload); i++ )
    {
        crc16( test_payload[i], &working_crc );
    }

    payload_crc = working_crc;
    working_crc = CRC_SEED;


    event_queue = xQueueCreate(EVT_QUEUE_SIZE, sizeof(radio_event_t));
    if (event_queue == NULL)
    {
        ESP_LOGE(TAG, "Create queue fail");
        return;
    }

    // Start tasks
    radio_init();
    xTaskCreate(benchmark_task, "benchmark_task", 2048, NULL, 4, NULL);
}

/* -------------------------------------------------------------------------- */