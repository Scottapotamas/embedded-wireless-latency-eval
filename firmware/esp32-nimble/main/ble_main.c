/* -------------------------------------------------------------------------- */

#define SERVER 0
#define CLIENT 1
#define BLE_SPP_MODE (SERVER)
// #define BLE_SPP_MODE (CLIENT)

// Packet size test length settings
// #define PAYLOAD_12B
#define PAYLOAD_128B
// #define PAYLOAD_1024B

/* -------------------------------------------------------------------------- */

#include <stdlib.h>
#include <stdio.h>
#include <string.h>
#include <assert.h>
#include <inttypes.h>

#include "freertos/FreeRTOS.h"
#include "freertos/semphr.h"
#include "freertos/timers.h"
#include "freertos/task.h"

#include "nvs_flash.h"
#include "esp_log.h"
#include "driver/gpio.h"

#include "ble_main_defs.h"

#if BLE_SPP_MODE == SERVER
    #include "server.h"
#else
    #include "client.h"
#endif

/* -------------------------------------------------------------------------- */

// Test stimulus input pin
#define GPIO_INPUT_IO_0     19
#define GPIO_INPUT_PIN_SEL  ((1ULL<<GPIO_INPUT_IO_0))

// Status output pin
#define GPIO_OUTPUT_IO_0    18
#define GPIO_OUTPUT_IO_LED  2   // onboard LED signals if the board has added a peer

#define GPIO_OUTPUT_PIN_SEL  ((1ULL<<GPIO_OUTPUT_IO_0) | (1ULL<<GPIO_OUTPUT_IO_LED))

#define ESP_INTR_FLAG_DEFAULT 0

/* -------------------------------------------------------------------------- */

static const char *TAG = "espble";

#define SPP_QUEUE_SIZE (8)
static QueueHandle_t spp_evt_queue;

#define SPP_DATA_MAX_LEN (193)

/* -------------------------------------------------------------------------- */

volatile bool trigger_pending = false;

#define CRC_SEED (0xFFFFu)
uint16_t bytes_read = 0;
uint16_t bytes_sent = 0;
uint16_t bytes_pending = 0;

uint16_t working_crc = CRC_SEED;
uint16_t payload_crc = 0x00;

#if defined(PAYLOAD_12B)
    uint8_t test_payload[12] = {
            0x00,
            0x01, 0x02, 0x03, 0x04, 0x05,
            0x06, 0x07, 0x08, 0x09, 0x0A,
            0x0B,
    };
#elif defined(PAYLOAD_128B)
    uint8_t test_payload[128] = {
            0x00,
            0x01, 0x02, 0x03, 0x04, 0x05, 0x06, 0x07, 0x08, 0x09, 0x0A,
            0x0B, 0x0C, 0x0D, 0x0E, 0x0F, 0x10, 0x11, 0x12, 0x13, 0x14,
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            0x79, 0x7A, 0x7B, 0x7C, 0x7D, 0x7E, 0x7F,
    };
#elif defined(PAYLOAD_1024B)
    uint8_t test_payload[1024] = {
            0x00,
            // Sequential set of 255 bytes
            0x01, 0x02, 0x03, 0x04, 0x05, 0x06, 0x07, 0x08, 0x09, 0x0A,
            0x0B, 0x0C, 0x0D, 0x0E, 0x0F, 0x10, 0x11, 0x12, 0x13, 0x14,
            0x15, 0x16, 0x17, 0x18, 0x19, 0x1A, 0x1B, 0x1C, 0x1D, 0x1E,
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            0xFB, 0xFC, 0xFD, 0xFE, 0xFF,

            // Next run of 255 bytes consumes 510 bytes
            0x01, 0x01, 0x01, 0x02, 0x01, 0x03, 0x01, 0x04,0x01, 0x05,
            0x01, 0x06, 0x01, 0x07, 0x01, 0x08, 0x01, 0x09,0x01, 0x0A,
            0x01, 0x0B, 0x01, 0x0C, 0x01, 0x0D, 0x01, 0x0E,0x01, 0x0F,
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            0x01, 0xFB, 0x01, 0xFC, 0x01, 0xFD, 0x01, 0xFE,  0x01, 0xFF,

            // 1+255+510 bytes are done, this is the remaining 258B for total of 1024
            0x02, 0x01, 0x02, 0x02, 0x02, 0x03, 0x02, 0x04, 0x02, 0x05,
            0x02, 0x06, 0x02, 0x07, 0x02, 0x08, 0x02, 0x09, 0x02, 0x0A,
            0x02, 0x0B, 0x02, 0x0C, 0x02, 0x0D, 0x02, 0x0E, 0x02, 0x0F,
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            0x02, 0x7E, 0x02, 0x7F, 0x02, 0x80, 0x02, 0x81
    };
#endif

/* -------------------------------------------------------------------------- */

static void setup_gpio_output( void );
static void setup_gpio_input( void );
static void IRAM_ATTR gpio_isr_handler(void* arg);

static void crc16(uint8_t data, uint16_t *crc);

static void benchmark_task(void *pvParameter);

/* -------------------------------------------------------------------------- */

void setup_gpio_output( void )
{
    gpio_config_t io_conf = {};

    // Output pin
    io_conf.intr_type = GPIO_INTR_DISABLE;
    io_conf.mode = GPIO_MODE_OUTPUT;
    io_conf.pin_bit_mask = GPIO_OUTPUT_PIN_SEL;
    io_conf.pull_down_en = 0;
    io_conf.pull_up_en = 0;
    gpio_config(&io_conf);
}

/* -------------------------------------------------------------------------- */

void setup_gpio_input( void )
{
    gpio_config_t io_conf = {};

    // Input pin with rising edge interrupt
    io_conf.intr_type = GPIO_INTR_POSEDGE;
    io_conf.mode = GPIO_MODE_INPUT;
    io_conf.pin_bit_mask = GPIO_INPUT_PIN_SEL;
    io_conf.pull_down_en = 0;
    io_conf.pull_up_en = 0;
    gpio_config(&io_conf);

    // ISR setup
    gpio_install_isr_service(ESP_INTR_FLAG_DEFAULT);
    gpio_isr_handler_add(GPIO_INPUT_IO_0, gpio_isr_handler, (void*) GPIO_INPUT_IO_0);
}

static void IRAM_ATTR gpio_isr_handler(void* arg)
{
    trigger_pending = true;
}

/* -------------------------------------------------------------------------- */

static void crc16(uint8_t data, uint16_t *crc)
{
    *crc  = (uint8_t)(*crc >> 8) | (*crc << 8);
    *crc ^= data;
    *crc ^= (uint8_t)(*crc & 0xff) >> 4;
    *crc ^= (*crc << 8) << 4;
    *crc ^= ((*crc & 0xff) << 4) << 1;
}

/* -------------------------------------------------------------------------- */

void app_main(void)
{
    // Initialize NVS
    // nvs_flash_erase();
    esp_err_t ret = nvs_flash_init();


    if (ret == ESP_ERR_NVS_NO_FREE_PAGES || ret == ESP_ERR_NVS_NEW_VERSION_FOUND)
    {
        ESP_ERROR_CHECK( nvs_flash_erase() );
        ret = nvs_flash_init();
    }
    ESP_ERROR_CHECK( ret );

    // General setup
    setup_gpio_output();
    setup_gpio_input();

    // Work out the correct CRC for the active payload
    working_crc = CRC_SEED;
    for( uint16_t i = 0; i < sizeof(test_payload); i++ )
    {
        crc16( test_payload[i], &working_crc );
    }

    payload_crc = working_crc;
    working_crc = CRC_SEED;

    // Useful callback events need a queue for user-space handling 
    spp_evt_queue = xQueueCreate(SPP_QUEUE_SIZE, sizeof(spp_event_t));
    if (spp_evt_queue == NULL)
    {
        ESP_LOGE(TAG, "Failed to create user-space evt queue");
        return;
    }

    // Bluetooth Setup
    // ESP_ERROR_CHECK(esp_bt_controller_mem_release(ESP_BT_MODE_CLASSIC_BT));

#if BLE_SPP_MODE == SERVER
    ble_server_setup();
    ble_server_register_user_evt_queue( &spp_evt_queue );
#else
    ble_client_setup();
    ble_client_register_user_evt_queue( &spp_evt_queue );
#endif

    // Start benchmark logic task
    xTaskCreate(benchmark_task, "benchmark_task", 2048, NULL, 4, NULL);
}

/* -------------------------------------------------------------------------- */

static void benchmark_task(void *pvParameter)
{
    spp_event_t evt;
    uint16_t bytes_sent = 0;

    while(1)
    {
        if( trigger_pending )
        {

            // Chunk large payloads into smaller packets
            bytes_sent = 0;

            uint16_t bytes_to_send = sizeof(test_payload) - bytes_sent;
            if( bytes_to_send > SPP_DATA_MAX_LEN )
            {
                bytes_to_send = SPP_DATA_MAX_LEN;
            }
            
            // ESP_LOGI(TAG, "Trig. Sending %iB", bytes_to_send );

#if BLE_SPP_MODE == SERVER
            ble_server_send_payload( &test_payload[bytes_sent], bytes_to_send );
            // We use ESP_GATTS_CONF_EVT to get positive confirmation that the notification
            // was recieved by the client
            bytes_pending = bytes_to_send;
#else
            ble_client_send_payload( &test_payload[bytes_sent], bytes_to_send );
#endif
            
            trigger_pending = false;
        }

        // Handle inbound data from callbacks
        if( xQueueReceive(spp_evt_queue, &evt, 1) )
        {
            switch( evt.id )
            {
                // Previously sent a packet
                case SPP_SEND_CB:
                {
                    spp_event_send_cb_t *send_cb = &evt.data.send_cb;

                    // ESP_LOGI(TAG, "At %i, Wrote %"PRIu32"B, CON: %i", bytes_sent, send_cb->bytes_sent, send_cb->congested);

                    // Update index of sent data (for multi-packet transfers)
                    bytes_sent += bytes_pending;
                    bytes_pending = 0;
                    // Send the next chunk if needed
                    if( bytes_sent < sizeof(test_payload) )
                    {
                        uint16_t bytes_to_send = sizeof(test_payload) - bytes_sent;
                        if( bytes_to_send > SPP_DATA_MAX_LEN )
                        {
                            bytes_to_send = SPP_DATA_MAX_LEN;
                        }

                        // ESP_LOGI(TAG, "Cont. Sending %iB", bytes_to_send );

#if BLE_SPP_MODE == SERVER
                        ble_server_send_payload( &test_payload[bytes_sent], bytes_to_send );
                        bytes_pending = bytes_to_send;
#else
                        ble_client_send_payload( &test_payload[bytes_sent], bytes_to_send );
#endif
                    }
                    else
                    {
                        bytes_sent = 0;
                        bytes_pending = 0;
                        // ESP_LOGI(TAG, "FIN \n");
                    }
  
                    break;
                } // end tx callback handling

                case SPP_RECV_CB:
                {
                    // Destructure the callback into something more ergonomic
                    spp_event_recv_cb_t *recv_cb = &evt.data.recv_cb;

                    // ESP_LOGI(TAG, "Got %"PRIu32"B", recv_cb->data_len);

                    for( uint16_t i = 0; i < recv_cb->data_len; i++ )
                    {
                        // Reset the "parser" if the start of a new test structure is seen
                        if(recv_cb->data[i] == 0x00 )
                        {
                            bytes_read = 0;
                            working_crc = CRC_SEED;
                            // ESP_LOGI(TAG, "RESET\n");
                        }

                        // Running crc and byte count
                        crc16( recv_cb->data[i], &working_crc );
                        bytes_read++;

                        // Identify the end of the packet via expected length and correct CRC
                        if( bytes_read == sizeof(test_payload) && working_crc == payload_crc )
                        {
                            // Valid test structure
                            gpio_set_level( GPIO_OUTPUT_IO_0, 1 );
                            // ESP_LOGI(TAG, "GOOD \n");
                        }
                    }

                    gpio_set_level( GPIO_OUTPUT_IO_0, 0 );
                    
                    // The rx callback uses malloc to store the inbound data
                    // so clean up after we're done handling that data
                    free( recv_cb->data );

                    break;
                }   // end rx callback handling

                default:
                    ESP_LOGE(TAG, "Invalid callback type: %d", evt.id);
                    break;
            }
        }   // end evtxQueueReceive

    }   // end event loop
}

/* -------------------------------------------------------------------------- */